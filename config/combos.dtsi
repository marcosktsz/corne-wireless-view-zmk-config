/*                KEY POSITIONS

  ╭────────────────────────╮ ╭────────────────────────╮
  │  0   1   2   3   4   5 │ │  6   7   8   9  10  11 │
  │ 12  13  14  15  16  17 │ │ 18  19  20  21  22  23 │
  │ 24  25  26  27  28  29 │ │ 30  31  32  33  34  35 │
  ╰───────╮ 36  37  38     │ │     39  40  41 ╭───────╯
          ╰────────────────╯ ╰────────────────╯

  Using urob-style naming:
  ╭─────────────────────╮ ╭─────────────────────╮
  │ LT4 LT3 LT2 LT1 LT0 │ │ RT0 RT1 RT2 RT3 RT4 │
  │ LM4 LM3 LM2 LM1 LM0 │ │ RM0 RM1 RM2 RM3 RM4 │
  │ LB4 LB3 LB2 LB1 LB0 │ │ RB0 RB1 RB2 RB3 RB4 │
  ╰───────╮ LH2 LH1 LH0 │ │ RH0 RH1 RH2 ╭───────╯
          ╰─────────────╯ ╰─────────────╯ */

// Corne 42-key mapping (excluding outer columns):
// LT4=1  LT3=2  LT2=3  LT1=4  LT0=5  | RT0=6  RT1=7  RT2=8  RT3=9  RT4=10
// LM4=13 LM3=14 LM2=15 LM1=16 LM0=17 | RM0=18 RM1=19 RM2=20 RM3=21 RM4=22
// LB4=25 LB3=26 LB2=27 LB1=28 LB0=29 | RB0=30 RB1=31 RB2=32 RB3=33 RB4=34
//        LH2=36 LH1=37 LH0=38         |        RH0=39 RH1=40 RH2=41

#define COMBO_TERM_FAST 18
#define COMBO_TERM_SLOW 30

#define COMBO_IDLE_FAST 150
#define COMBO_IDLE_SLOW 50

// Define layer numbers - adjust these to match your keymap
#define DEF 0  // default layer
#define LOW 1  // lower layer
#define RSE 2  // raise layer
#define MED 3  // media layer

/ {
    combos {
        compatible = "zmk,combos";

        /* Critical layer activation - dual thumb cluster */
        combo_critical_layer {
            timeout-ms = <COMBO_TERM_SLOW>;
            require-prior-idle-ms = <COMBO_IDLE_SLOW>;
            key-positions = <36 41>; // LH2 RH2 (outer thumb keys)
            bindings = <&mo 4>;  // Momentary activation of critical layer
            layers = <DEF LOW RSE MED>;
        };

    };
};
